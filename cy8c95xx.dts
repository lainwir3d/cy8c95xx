/*
 * Author: Richard Rondu
 *
 * Sample device tree overlay for Cypress CY8C95XX I/O expanders.
 */

/dts-v1/;
/plugin/;

/ {
	compatible = "brcm,bcm2708";
	
	fragment@0 {
		target = <&i2c1>;

		__overlay__ {
			status = "okay";
			#address-cells = <1>;
			#size-cells = <0>;
			cy8c95xx: cy8c95xx@20 {
                                compatible = "cypress,cy8c95xx";
                                reg = <0x20>;
                                
                                gpio-controller;
                                #gpio-cells = <2>;
				
                                interrupt-controller;
                                interrupt-parent = <&gpio>;
                                #interrupt-cells = <2>;
                                interrupts = <21 1>;  // 1 = edge rising
			};
		};
	};
};
